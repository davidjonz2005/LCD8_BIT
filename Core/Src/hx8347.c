/**********************************************************
320x240 LCD
HX8347-A Controller

Ryan Milewski 5/2/11
blackrynius.wordpress.com
*********************************************************/




unsigned const char FONT8x8[99][8] = {
0x08,0x08,0x08,0x00,0x00,0x00,0x00,0x00, // columns, rows, num_bytes_per_char
0x00,0x00,0x00,0x00,0x00,0x00,0x00,0x00, // space 0x20
0x30,0x78,0x78,0x30,0x30,0x00,0x30,0x00, // !
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0x22,0x77,0x7f,0x7f,0x3e,0x1c,0x08,0x00	 //HEART use:
};


//Code provided with LCD-----------------------
void LCD_write_COM(int data)
{
	LCD_RS_LOW;
	LCD_CS = 0;
	DBhigh = data>>8;
	DBlow = data;
	LCD_WR = 0;
	LCD_WR=1;
	LCD_CS=1;
}

void LCD_write_DATA(int data)
{
	LCD_RS = 1;
	LCD_CS = 0;
	DBhigh = data>>8;
	DBlow = data;
	LCD_WR = 0;
	LCD_WR = 1;
	LCD_CS = 1;
}

void LCD_write_COM_DATA(int com, int data)
{
	LCD_write_COM(com);
	LCD_write_DATA(data);
}

void LCD_init(void)
{
	LCD_REST = 1;
	Delay10KTCYx(1);	//5ms delay
	LCD_REST = 0;
	Delay10KTCYx(3);	//10ms delay
	LCD_REST = 1;
	Delay10KTCYx(3);	//20ms delay
	
	//Vendor gamma
	LCD_write_COM_DATA(0x0046,0x00a4);
	LCD_write_COM_DATA(0x0047,0x0053);
	LCD_write_COM_DATA(0x0048,0x0000);
	LCD_write_COM_DATA(0x0049,0x0044);
	LCD_write_COM_DATA(0x004a,0x0004);
	LCD_write_COM_DATA(0x004b,0x0067);
	LCD_write_COM_DATA(0x004c,0x0033);
	LCD_write_COM_DATA(0x004d,0x0077);
	LCD_write_COM_DATA(0x004e,0x0012);
	LCD_write_COM_DATA(0x004f,0x004c);
	LCD_write_COM_DATA(0x0050,0x0046);
	LCD_write_COM_DATA(0x0051,0x0044);
	

	//240x320 window settings
	LCD_write_COM_DATA(0x0002,0x0000);	//Column address start2
	LCD_write_COM_DATA(0x0003,0x0000);	//column address start1
	LCD_write_COM_DATA(0x0004,0x0000);	//Column address end2
	LCD_write_COM_DATA(0x0005,0x00ef);	//Column address end1
	LCD_write_COM_DATA(0x0006,0x0000);	//Row address start2
	LCD_write_COM_DATA(0x0007,0x0000);	//Row address start1
	LCD_write_COM_DATA(0x0008,0x0001);	//Row address end2
	LCD_write_COM_DATA(0x0009,0x003f);	//Row address end1
	
	//display settings
	LCD_write_COM_DATA(0x0001,0x0006);	//IDMON=0,INVON=1,NORON=1,PTLON=0
	LCD_write_COM_DATA(0x0016,0x00c8);	//MY=0,MX=0,MV=0,ML=1,BGR=0,TEON=0
	LCD_write_COM_DATA(0x0023,0x0095);	//N_DC=1001 0101
	LCD_write_COM_DATA(0x0024,0x0095);	//PI_DC=1001 0101
	LCD_write_COM_DATA(0x0025,0x00ff);	//I_DC=1111 1111
	
	LCD_write_COM_DATA(0x0027,0x0002);	//N_BP=0000 0010
	LCD_write_COM_DATA(0x0028,0x0002);	//N_FP=0000 0010
	LCD_write_COM_DATA(0x0029,0x0002);	//PI_BP=0000 0010
	LCD_write_COM_DATA(0x002a,0x0002);	//PI_FP=0000 0010
	LCD_write_COM_DATA(0x002c,0x0002);	//I_BP=0000 0010
	LCD_write_COM_DATA(0x002d,0x0002);	//I_FP=0000 0010
	
	LCD_write_COM_DATA(0x003a,0x0001);	//N_RTN=0000,N_NW=001
	LCD_write_COM_DATA(0x003b,0x0000);	//P_RTN=0000,P_NW=001
	LCD_write_COM_DATA(0x003c,0x00f0);	//I_RTN=1111,I_NW=000
	LCD_write_COM_DATA(0x003d,0x0000);	//DIV=00
	Delay1KTCYx(2);	//1ms delay
	LCD_write_COM_DATA(0x0035,0x0038);	//EOS=38h
	LCD_write_COM_DATA(0x0036,0x0078);	//EQP=78h
	LCD_write_COM_DATA(0x003e,0x0038);	//SON=38h
	LCD_write_COM_DATA(0x0040,0x000f);	//GDON=0fh
	LCD_write_COM_DATA(0x0041,0x00f0);	//GDOFF
	
	//Power Supply Settings
	LCD_write_COM_DATA(0x0019,0x0049);	//CADJ=0100,CUADJ=100,OSD_EN=1,60Hz
	LCD_write_COM_DATA(0x0093,0x000f);	//RADJ=1111, 100%
	Delay1KTCYx(2);	//1ms delay
	LCD_write_COM_DATA(0x0020,0x0040);	//BT=0100
	LCD_write_COM_DATA(0x001d,0x0007);	//VC1=111
	LCD_write_COM_DATA(0x001e,0x0000);	//VC3=000
	LCD_write_COM_DATA(0x001f,0x0004);	//VRH=0011
	
	//VCOM Settings
	LCD_write_COM_DATA(0x0044,0x004d);	//VCM=101 0000
	LCD_write_COM_DATA(0x0045,0x000e);	//VDV=1 0001
	Delay1KTCYx(2);	//1ms delay
	LCD_write_COM_DATA(0x001c,0x0004);	//AP=100
	Delay1KTCYx(4);	//2ms delay
	LCD_write_COM_DATA(0x001b,0x0018);	//GASENB=0,PON=1,DK=1,XDK=0,VLCD TRI=0,STB=0
	Delay1KTCYx(2);	//1ms delay
	LCD_write_COM_DATA(0x001b,0x0010);	//GASENB=0,PON=1,DK=0,XDK=0,VLCD TRI=0,STB=0
	Delay1KTCYx(2);	//1ms delay
	LCD_write_COM_DATA(0x0043,0x0080);	//set VCOMG=1
	Delay1KTCYx(4);	//2ms delay
	
	//Display On Setting
	LCD_write_COM_DATA(0x0090,0x007f);	//SAP=0111 1111
	LCD_write_COM_DATA(0x0026,0x0004);	//GON=0,DTE=0,D=01
	Delay1KTCYx(2);	//1ms delay
	LCD_write_COM_DATA(0x0026,0x0024);	//GON=1,DTE=0,D=01
	LCD_write_COM_DATA(0x0026,0x002c);	//GON=1,DTE=0,D=11
	Delay1KTCYx(2);	//1ms delay
	LCD_write_COM_DATA(0x0026,0x003c);	//GON=1,DTE=1,D=11
	
	//Internal Register Settings
	LCD_write_COM_DATA(0x0057,0x0002);	//TEST_Mode=1: into test mode
	LCD_write_COM_DATA(0x0095,0x0001);	//SET DISPLAY CLOCK AND PUMPKING CLOCK TO SYCRONIZE
	LCD_write_COM_DATA(0x0057,0x0000);	//TEST Mode=0:exit TEST Mode
	
	LCD_write_COM(0x0022);	
}

void LCD_address_set(unsigned int x1, unsigned int y1, unsigned int x2, unsigned int y2)
{
	LCD_write_COM_DATA(0x0002,x1>>8);		//Column address start2
	LCD_write_COM_DATA(0x0003,x1);	//Column address start1
	LCD_write_COM_DATA(0x0004,x2>>8);		//column address end2
	LCD_write_COM_DATA(0x0005,x2);	//column address end1
	
	LCD_write_COM_DATA(0x0006,y1>>8);		//Row address start2
	LCD_write_COM_DATA(0x0007,y1);	//row address start1
	LCD_write_COM_DATA(0x0008,y2>>8);		//row address end2
	LCD_write_COM_DATA(0x0009,y2);	//row address end1

	LCD_write_COM(0x0022);
}

void LCD_fill_screen(unsigned int color)
{
	int i,j;
	LCD_address_set(0,0,239,319);
	
	for(i=0;i<320;i++)
	{
		for(j=0;j<240;j++)
		{
		LCD_write_DATA(color);
		}
	}
}//end of LCD_fill_screen()

//end of code provided-----------------------------------------


//-------------------------------
//Function:
//LCD_set_pixel(5,10,BLACK)
//-Sets pixel at (x,y) color specified
//-------------------------------
void LCD_set_pixel(unsigned int x, unsigned int y, unsigned int color)
{
	LCD_address_set(x,y,x,y);
	LCD_write_DATA(color);
	
}//end of LCD_set_pixel---------

/************************************
Function:
LCD_color_test()
-Fills screen with pixel of every color available.
*************************************/

void LCD_color_test(void)
{
	unsigned int i,j,k,color;
	color=0;

	for (i=0;i<320;i++)
	{
		for (j=0;j<240;j++)
		{
			LCD_write_DATA(color++);
		}
	}
}//end of LCD_color_test()


/***************************************
Function:
LCD_put_char('R',10,20,BLACK,WHITE);

-prints char at (10,20) in black agianst white background
-(x,y) => Top, Left corner of character
***************************************/

void LCD_put_char(unsigned char c, int x, int y, int fcolor, int bcolor)
{
	int i,j;
	unsigned int nCols,nRows,nBytes,Word0,Word1;
	unsigned char PixelRow,Mask;
	unsigned rom char *pFont,*pChar;

	//Set pointer to font table
	pFont = *FONT8x8;

	//get the nCol, nRows and nBytes
	nCols = *pFont;
	nRows = *(pFont + 1);
	nBytes = *(pFont + 2);

	//Get pointer to last byte of desired char
	pChar = pFont + (nBytes * (c-0x1f));// + nBytes -1
	
	//Address Set
	LCD_address_set(x,y,x+nRows-1,y+nCols-1);

	//loop on each row, working backwards
	for(i=nRows-1;i>=0;i--)
	{
		PixelRow = *pChar++;
		Mask = 0x80;
		for(j=0;j<nCols;j += 2)
		{
			if((PixelRow & Mask) == 0)
				Word0 = bcolor;
			else
				Word0 = fcolor;
			Mask = Mask>>1;
			if((PixelRow & Mask) ==0)
				Word1 = bcolor;
			else
				Word1 = fcolor;
			Mask = Mask>>1;

			//LCD Portrait orientation
			LCD_write_DATA(Word0);
			LCD_write_DATA(Word1);

			/****************************
			COde for including orientation modes
			will print char. in Landscape orientation

			LCD_set_pixel(x+i,y+j,Word0);
			LCD_set_pixel(x+i,y+j+1,Word1);
			********************************/
		}
	}
}//end of LCD_put_char

/****************************************************
Function:
LCD_put_str(buffer,20,40,RED,BLACK);

Cast as:
char buffer[]="Ryan";

-prints string in buffer starting at (20,40)
-rolls over to next line starting at x
-(x,y) => Top,Left of 1st character
-'\n' = new line
******************************************************/
void LCD_put_str(unsigned char *pString, int x, int y, int fcolor, int bcolor)
{
	unsigned char old_x,old_y,orig_x;
	old_x = x;
	orig_x = x;
	old_y = y;

	while(*pString != 0x00)
	{
	switch (*pString) 
	{
     	case '\n':
			x=(orig_x - 8);
			y+=10;
			*pString++;
			break;
     //	case '\b'   : lcd_send_byte(0,0x10);  break;
     	default:
			LCD_put_char(*pString++,x,y,fcolor,bcolor);
			break;
	}
	//advance x position
	x = x+8;
	if (x>231)
		{
		x=orig_x;
		y+=10;
		}
	if (y>=320) break;
	}


}//end of LCD_put_str()


/**************************************************************
Function:
LCD_put_rom_str("Black Rynius",50,60,GREEN,BLACK);

-prints text in double quotes
-(x,y) => Top,Left of 1st character
-'\n' = new line
***************************************************************/

void LCD_put_rom_str(unsigned rom char *pString, int x, int y, int fcolor, int bcolor)
{
	unsigned char old_x,old_y,orig_x;
	old_x = x;
	orig_x = x;
	old_y = y;

	while(*pString != 0x00)
	{
	switch (*pString) 
	{
     	case '\n':
			x=(orig_x - 8);
			y+=10;
			*pString++;
			break;
     //	case '\b'   : lcd_send_byte(0,0x10);  break;
     	default:
			LCD_put_char(*pString++,x,y,fcolor,bcolor);
			break;
  	}

	
	//advance x position
	x = x+8;
	if (x>231)
		{
		x=orig_x;
		y+=10;
		}
	if (y>=320) break;

	}


}//end of LCD_put_str()


/****************************************************************************
Purpose:	Draw a line using Bresenham's function
Inputs:		(x1,y1) - 1st point of line
            (x2,y2) - 2nd point of line
            color - COLOR define or 16-bit RGB hex#
***************************************************************/
void LCD_draw_line(unsigned int x1,unsigned int y1,unsigned int x2,unsigned int y2, unsigned int color)
{
   signed int  x, y, addx, addy, dx, dy;
   signed long P;
   int i;
   dx = fabs((signed int)(x2 - x1));
   dy = fabs((signed int)(y2 - y1));
   x = x1;
   y = y1;

   if(x1 > x2)
      addx = -1;
   else
      addx = 1;
   if(y1 > y2)
      addy = -1;
   else
      addy = 1;

   if(dx >= dy)
   {
      P = 2*dy - dx;

      for(i=0; i<=dx; ++i)
      {
         LCD_set_pixel(x, y, color);

         if(P < 0)
         {
            P += 2*dy;
            x += addx;
         }
         else
         {
            P += 2*dy - 2*dx;
            x += addx;
            y += addy;
         }
      }
   }
   else
   {
      P = 2*dx - dy;

      for(i=0; i<=dy; ++i)
      {
         LCD_set_pixel(x, y, color);

         if(P < 0)
         {
            P += 2*dx;
            y += addy;
         }
         else
         {
            P += 2*dx - 2*dy;
            x += addx;
            y += addy;
         }
      }
   }
}
//-------------------------------------------------------------------


/****************************************************************************
Purpose:       Draw a circle on a graphic LCD
Inputs:        (x,y) - the center of the circle
                radius - the radius of the circle
                fill - 0= NO, 1=YES
                color - COLOR or 16-bit RGB hex#
***************************************************************/
void LCD_draw_circle(unsigned int x, unsigned int y, int radius,int fill, unsigned int color)
{
   signed int a, b, P;
   a = 0;
   b = radius;
   P = 1 - radius;

   do
   {
      if(fill)
      {
         LCD_draw_line(x-a, y+b, x+a, y+b, color);
         LCD_draw_line(x-a, y-b, x+a, y-b, color);
         LCD_draw_line(x-b, y+a, x+b, y+a, color);
         LCD_draw_line(x-b, y-a, x+b, y-a, color);
      }
      else
      {
         LCD_set_pixel(a+x, b+y, color);
         LCD_set_pixel(b+x, a+y, color);
         LCD_set_pixel(x-a, b+y, color);
         LCD_set_pixel(x-b, a+y, color);
         LCD_set_pixel(b+x, y-a, color);
         LCD_set_pixel(a+x, y-b, color);
         LCD_set_pixel(x-a, y-b, color);
         LCD_set_pixel(x-b, y-a, color);
      }

      if(P < 0)
         P+= 3 + 2*a++;
      else
         P+= 5 + 2*(a++ - b--);
    } while(a <= b);
}//end of LCD_draw_circle-----------------------------------------------

/****************************************************************************
Purpose:	Draw a rectangle on a graphic LCD
Inputs:		(x1,y1) - top left corner of rectangle
			(x2,y2)	- bottom right corner
            fill - 0= NO, 1=YES
            color - COLOR or 16-bit RGB hex#
***************************************************************/
void LCD_draw_rect(unsigned int x1, unsigned int y1, unsigned int x2, unsigned int y2, unsigned int color, int fill)
{
	int i,j;

	LCD_address_set(x1,y1,x2,y2);
	
	if (fill)
	{
		for(i=0;i<=(x2-x1);i++)
		{
			for(j=0;j<=(y2-y1);j++)
			{
			LCD_write_DATA(color);
			}
		}
	}
	else
	{
		LCD_draw_line(x1,y1,x1,y2,color);
		LCD_draw_line(x1,y2,x2,y2,color);
		LCD_draw_line(x2,y1,x2,y2,color);
		LCD_draw_line(x1,y1,x2,y1,color);
	}	
}//end of LCD_draw rect--------------





